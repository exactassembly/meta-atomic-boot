## conf/layer.conf
```bitbake
# We have a conf and classes directory, append to BBPATH
BBPATH .= ":${LAYERDIR}"

# We have a recipes directory, add to BBFILES
BBFILES += "${LAYERDIR}/recipes*/*/*.bb ${LAYERDIR}/recipes*/*/*.bbappend"

BBFILE_COLLECTIONS += "meta-atomic-boot"
BBFILE_PATTERN_meta-atomic-boot := "^${LAYERDIR}/"

LAYERSERIES_COMPAT_meta-atomic-boot = "mickledore"
```
